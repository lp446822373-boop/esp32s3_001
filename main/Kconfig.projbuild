## main/Kconfig.projbuild
```kconfig
menu "Canteen Terminal"

    config CANTEEN_VOICE_TRACK_SUCCESS
        int "SUCCESS 提示音曲目编号"
        range 0 65535
        default 2
        help
            扫码结果 SUCCESS 时播放的音频模块曲目编号，高字节在前发送。
            0 表示不播放提示音。

    config CANTEEN_VOICE_TRACK_FAILED
        int "FAILED 提示音曲目编号"
        range 0 65535
        default 4
        help
            服务端返回 FAILED 时播放的曲目编号。

    config CANTEEN_VOICE_TRACK_PENDING
        int "PENDING 提示音曲目编号"
        range 0 65535
        default 1
        help
            服务端返回 PENDING、需要员工在手机确认时播放的曲目编号。

    config CANTEEN_VOICE_TRACK_UNCONFIRMED
        int "未确认提示音曲目编号"
        range 0 65535
        default 3
        help
            断网、超时、HTTP 异常或响应无法解析时播放的曲目编号。

    config CANTEEN_DISPLAY_ENABLE
        bool "启用 I2C OLED 显示屏"
        default y
        help
            启用后初始化 SSD1306 OLED 并在后台刷新界面。
            屏幕属于可选外设，初始化失败不会影响扫码、联网和语音。

    config CANTEEN_DISPLAY_I2C_SDA_GPIO
        int "OLED I2C SDA GPIO"
        range 0 48
        default 8

    config CANTEEN_DISPLAY_I2C_SCL_GPIO
        int "OLED I2C SCL GPIO"
        range 0 48
        default 9

    config CANTEEN_DISPLAY_I2C_ADDR
        hex "OLED I2C 地址"
        default 0x3C

    config CANTEEN_DISPLAY_HEIGHT
        int "OLED 行数"
        range 32 64
        default 64

    config CANTEEN_DISPLAY_CONTRAST
        int "OLED 对比度"
        range 1 255
        default 128

    config CANTEEN_DISPLAY_RESULT_HOLD_MS
        int "扫码结果页停留时间（毫秒）"
        range 1000 60000
        default 5000

    config CANTEEN_DISPLAY_SCROLL_MS
        int "长信息滚动间隔（毫秒）"
        range 20 2000
        default 100

endmenu
```

## sdkconfig.defaults
```kconfig
# WiFi 配网 + HTTP 服务需要更大的应用分区（1500 KB）
CONFIG_PARTITION_TABLE_SINGLE_APP_LARGE=y

# 手机浏览器请求头可能超过默认的 1 KB
CONFIG_HTTPD_MAX_REQ_HDR_LEN=2048

# 终端接口 HTTPS 客户端：使用内置 CA 证书包校验证书链和域名
CONFIG_MBEDTLS_CERTIFICATE_BUNDLE=y
CONFIG_MBEDTLS_CERTIFICATE_BUNDLE_DEFAULT_FULL=y

# 扫码结果提示音曲目编号（0 表示不播报），需与音频模块内的文件编号一致
CONFIG_CANTEEN_VOICE_TRACK_SUCCESS=2
CONFIG_CANTEEN_VOICE_TRACK_FAILED=4
CONFIG_CANTEEN_VOICE_TRACK_PENDING=1
CONFIG_CANTEEN_VOICE_TRACK_UNCONFIRMED=3
```
